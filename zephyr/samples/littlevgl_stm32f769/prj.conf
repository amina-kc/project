## CMakeLists.txt
```
# SPDX-License-Identifier: Apache-2.0

cmake_minimum_required(VERSION 3.8.2)

set(BOARD stm32f769i_disco)
include($ENV{ZEPHYR_BASE}/cmake/app/boilerplate.cmake NO_POLICY_SCOPE)
project(littlevgl_stm32f769)

target_sources(app PRIVATE src/main.c)
target_sources(app PRIVATE src/stm32f7xx_it.c)
#FILE(GLOB app_sources src/*.c)
#FILE(GLOB app_sources /home/amina/project/modules/hal/stm32/stm32cube/stm32f7xx/drivers/src/lv_examples/*/*/*.c)
FILE(GLOB app_sources /home/amina/project/modules/hal/stm32/stm32cube/stm32f7xx/drivers/src/lv_examples/lv_apps/demo/img_bubble_pattern.c)

include_directories(/home/amina/project/modules/hal/stm32/stm32cube/stm32f7xx/drivers/include)
include_directories(/home/amina/project/modules/hal/stm32/stm32cube/stm32f7xx/drivers/src)

target_sources(app PRIVATE ${app_sources})
```

## sample.yaml
```
sample:
  description: littlevgl for stm32f769 application
  name: littlevgl_stm32f769
tests:
  sample.gui.lvgl:
    harness: display
    tags: sample display test
```

## prj.conf
```kconfig
CONFIG_DISPLAY=y
CONFIG_HAS_STM32CUBE=y
CONFIG_GPIO=y
```

## src/main.c
```c
/**
 ******************************************************************************
 * @file    main.c
 * @author  Ac6
 * @version V1.0
 * @date    01-December-2013
 * @brief   Default main function.
 ******************************************************************************
 */


//#include "stm32f7xx.h"
//#include "stm32f769i_discovery.h"
#include <zephyr.h>
#include <device.h>
#include <drivers/gpio.h>
#include <tft.h>
#include <touchpad.h>
#include <lvgl.h>
#include "lv_examples/lv_tests/lv_test_theme/lv_test_theme_2.h"

//static void SystemClock_Config(void);
//static void CPU_CACHE_Enable(void);

int main(void)
{


	//HAL_Init();
	//SystemClock_Config();
	lv_init();
	tft_init();
	//touchpad_init();
	demo_create();
	//benchmark_create();
	//lv_test_theme_2(); */

	while(1) {
		lv_task_handler();
		k_sleep(5);
		
	}
}
```

## src/stm32f7xx_it.c
```c
/**
  ******************************************************************************
  * @file    stm32f7xx_it.c
  * @author  Ac6
  * @version V1.0
  * @date    02-Feb-2015
  * @brief   Default Interrupt Service Routines.
  ******************************************************************************
*/

/* Includes ------------------------------------------------------------------*/
#include "stm32f7xx_hal.h"
#include "stm32f7xx.h"
#ifdef USE_RTOS_SYSTICK
#include <cmsis_os.h>
#endif
#include "stm32f7xx_it.h"
#include "stm32f769i_discovery.h"
#include "stm32f769i_discovery_lcd.h"
//#include "lvgl.h"

/* Private typedef -----------------------------------------------------------*/
/* Private define ------------------------------------------------------------*/
/* Private macro -------------------------------------------------------------*/
/* Private variables ---------------------------------------------------------*/
extern DSI_HandleTypeDef hdsi_discovery;
extern DMA2D_HandleTypeDef hdma2d_discovery;
/* Private function prototypes -----------------------------------------------*/
/* Private functions ---------------------------------------------------------*/

/******************************************************************************/
/*            	  	    Processor Exceptions Handlers                         */
/******************************************************************************/

/**
  * @brief  This function handles SysTick Handler, but only if no RTOS defines it.
  * @param  None
  * @retval None
  */
/*void SysTick_Handler(void)
{
	//HAL_IncTick();
	//HAL_SYSTICK_IRQHandler();
	lv_tick_inc(1);
#ifdef USE_RTOS_SYSTICK
	osSystickHandler();
#endif
}*/

/**
  * @brief  This function handles DSI Handler.
  * @param  None
  * @retval None
  */
void DSI_IRQHandler(void)
{
  HAL_DSI_IRQHandler(&hdsi_discovery);
}
void DMA2D_IRQHandler(void)
{
  HAL_DMA2D_IRQHandler(&hdma2d_discovery);
}
```
